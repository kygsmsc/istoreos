#include "mt7621_pplink_s21.dtsi"

/ {
	compatible = "pplink,s21-32m", "mediatek,mt7621-soc";
	model = "PP-LINK S21 (32M SPI NOR)";
};


&flash0 {
	broken-flash-reset;
};


&firmware {
	reg = <0x50000 0x1fb0000>;
};
